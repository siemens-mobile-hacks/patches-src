
-carm
-Z(CODE)PATCH_BODY,START,CODE,SWITAB,INITTAB,DATA_ID,DATA_C=A0FC1F00-FFFFFFFF

-Z(CODE)PATCH_DRAWOBJECT_OBJ05=A07F8764-FFFFFFFF
-Z(CODE)PATCH_DRAWOBJECT_OBJ17=A089EE8C-FFFFFFFF

//Дополнение

-Z(CODE)PATCH_DRAWOBJECT_OBJ05_J32=A0A33A34-FFFFFFFF
-Z(CODE)PATCH_DRAWOBJECT_OBJ17_J32=A0A33B40-FFFFFFFF

-Z(CODE)PATCH_REPAIRJUMP145=A0A33B3C-FFFFFFFF
-Z(CODE)PATCH_REPAIRJUMP100=A0A33A30-FFFFFFFF

-Z(CODE)PATCH_LOCALJUMP145=A0207048-FFFFFFFF //GBS_GetCurCepid (0x145)
-Z(CODE)PATCH_LOCALJUMP100=A020A770-FFFFFFFF //GBS_SendMessage (0x100)