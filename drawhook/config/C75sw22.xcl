
-carm
-Z(CODE)PATCH_BODY,START,CODE,SWITAB,INITTAB,DATA_ID,DATA_C=A10F1F00-FFFFFFFF

-Z(CODE)PATCH_DRAWOBJECT_OBJ05=A07A7CA8-FFFFFFFF
-Z(CODE)PATCH_DRAWOBJECT_OBJ17=A084312C-FFFFFFFF

//Дополнение

-Z(CODE)PATCH_DRAWOBJECT_OBJ05_J32=A09C3DEC-FFFFFFFF
-Z(CODE)PATCH_DRAWOBJECT_OBJ17_J32=A09C3EF8-FFFFFFFF

-Z(CODE)PATCH_REPAIRJUMP145=A09C3EF4-FFFFFFFF
-Z(CODE)PATCH_REPAIRJUMP100=A09C3DE8-FFFFFFFF

-Z(CODE)PATCH_LOCALJUMP145=A0207048-FFFFFFFF //GBS_GetCurCepid (0x145)
-Z(CODE)PATCH_LOCALJUMP100=A020A770-FFFFFFFF //GBS_SendMessage (0x100)