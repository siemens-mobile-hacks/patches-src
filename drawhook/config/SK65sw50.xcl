-carm
-Z(CODE)PATCH_BODY,CODE,DATA_I,DATA_C,DATA_Z=A0FC1F00-FFFFFFFF

-Z(CODE)PATCH_DRAWOBJECT_OBJ05=A0730770-FFFFFFFF
-Z(CODE)PATCH_DRAWOBJECT_OBJ17=A07CAFEC-FFFFFFFF

//Дополнение

-Z(CODE)PATCH_DRAWOBJECT_OBJ05_J32=A08F6804-FFFFFFFF
-Z(CODE)PATCH_DRAWOBJECT_OBJ17_J32=A08F61B4-FFFFFFFF


-Z(CODE)PATCH_REPAIRJUMP145=A08F6800-FFFFFFFF
-Z(CODE)PATCH_REPAIRJUMP100=A08F61B0-FFFFFFFF

-Z(CODE)PATCH_LOCALJUMP145=A0206B00-FFFFFFFF //GBS_GetCurCepid (0x145)
-Z(CODE)PATCH_LOCALJUMP100=A020A248-FFFFFFFF //GBS_SendMessage (0x100)