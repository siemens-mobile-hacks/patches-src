-carm
-Z(CODE)JHC_BODY,START,CODE,SWITAB,INITTAB,DATA_ID,DATA_C,CONFIG_DATA_ID=A0FC8000-FFFFFFFF
-Z(DATA)CODE_I,DATA_Z,DATA_N,DATA_I,CONFIG_DATA_I=A8479000-A847A000

/*

-D_SVC_STACK_SIZE=10
-D_IRQ_STACK_SIZE=100
-D_HEAP_SIZE=6FFFFF


-Z(DATA)CSTACK+_CSTACK_SIZE=RAMSTART-RAMEND
-Z(DATA)SVC_STACK+_SVC_STACK_SIZE=RAMSTART-RAMEND
-Z(DATA)IRQ_STACK+_IRQ_STACK_SIZE,HEAP+_HEAP_SIZE=A9000000-A979FFFF

*/

-Z(CODE)PATCH_SHEAP_SETUP=A0AD35D8-FFFFFFFF
-Z(CODE)PATCH_EHEAP_REMAP=A0B18394-FFFFFFFF

-Z(CODE)PATCH_BROWSER_CREATE=A07F6380-FFFFFFFF
-Z(CODE)PATCH_MMSCLIENT_CREATE=A02B6ECC-FFFFFFFF


-Z(CODE)PATCH_MALLOC=A0202F6C-FFFFFFFF
-Z(CODE)PATCH_MFREE=A02038D4-FFFFFFFF

//Develop Setup
-Z(CODE)PATCH_DS_MOPI_SM=A0219BF0-FFFFFFFF
-Z(CODE)PATCH_DS_OVERLAY_S=A04B4DD4-FFFFFFFF
-Z(CODE)PATCH_DS_OVERLAY_F=A04B4DE8-FFFFFFFF

//Java Heap
-Z(CODE)JHC_SETJHVARI=A0931D04-FFFFFFFF
-Z(CODE)JHC_GETJHADDR=A0931E50-FFFFFFFF


//SWI
-Z(CODE)SWI_MALLOC=A0FD4050-A0FD4053
-Z(CODE)SWI_MFREE=A0FD4054-A0FD4057
-Z(CODE)SWI_REALLOC=A0FD42E8-A0FD42EB
-Z(CODE)SWI_CALLOC=A0FD4248-A0FD424B
-Z(CODE)SWI_ALLOCWS=A0FD4248-A0FD4290
-Z(CODE)SWI_GETFREE=A0FD417C-A0FD417F

