-carm
-Z(CODE)JHC_BODY,START,CODE,SWITAB,INITTAB,DATA_ID,DATA_C,CONFIG_DATA_ID=A0FC8000-FFFFFFFF
-Z(DATA)CODE_I,DATA_Z,DATA_N,DATA_I,CONFIG_DATA_I=A87EF000-A87F0000 // ну наугад хз пересекается или нет

/*

-D_SVC_STACK_SIZE=10
-D_IRQ_STACK_SIZE=100
-D_HEAP_SIZE=6FFFFF


-Z(DATA)CSTACK+_CSTACK_SIZE=RAMSTART-RAMEND
-Z(DATA)SVC_STACK+_SVC_STACK_SIZE=RAMSTART-RAMEND
-Z(DATA)IRQ_STACK+_IRQ_STACK_SIZE,HEAP+_HEAP_SIZE=A9000000-A979FFFF

*/

-Z(CODE)PATCH_SHEAP_SETUP=A12B346C-FFFFFFFF
-Z(CODE)PATCH_EHEAP_REMAP=A12CE7B8-FFFFFFFF

-Z(CODE)PATCH_BROWSER_CREATE=A114EB32-FFFFFFFF
-Z(CODE)PATCH_MMSCLIENT_CREATE=A0A38E3C-FFFFFFFF


-Z(CODE)PATCH_MALLOC=A08202E4-FFFFFFFF
-Z(CODE)PATCH_MFREE=A0820C48-FFFFFFFF

//Develop Setup
-Z(CODE)PATCH_DS_MOPI_SM=A0836C20-FFFFFFFF
-Z(CODE)PATCH_DS_OVERLAY_S=A0931AC8-FFFFFFFF
-Z(CODE)PATCH_DS_OVERLAY_F=A0931ADC-FFFFFFFF

//Java Heap
-Z(CODE)JHC_SETJHVARI=A0CAA2D8-FFFFFFFF
-Z(CODE)JHC_GETJHADDR=FFFFFFFF-FFFFFFFF


//SWI
-Z(CODE)SWI_MALLOC=A0FD4050-A0FD4053
-Z(CODE)SWI_MFREE=A0FD4054-A0FD4057
-Z(CODE)SWI_REALLOC=A0FD42E8-A0FD42EB
-Z(CODE)SWI_CALLOC=A0FD4248-A0FD424B
-Z(CODE)SWI_ALLOCWS=A0FD4248-A0FD4290
-Z(CODE)SWI_GETFREE=A0FD417C-A0FD417F

